## build/conf/bblayers.conf
```bitbake
POKY_BBLAYERS_CONF_VERSION = "2"

BBPATH = "${TOPDIR}"
BBFILES ?= ""

BBLAYERS ?= " \
  ${TOPDIR}/../poky/meta \
  ${TOPDIR}/../poky/meta-poky \
  ${TOPDIR}/../meta-openembedded/meta-oe \
  ${TOPDIR}/../meta-openembedded/meta-python \
  ${TOPDIR}/../meta-openembedded/meta-networking \
  ${TOPDIR}/../meta-raspberrypi \
  ${TOPDIR}/../meta-mender/meta-mender-core \
  ${TOPDIR}/../meta-mender/meta-mender-raspberrypi \
  ${TOPDIR}/../meta-bitcoin \
  ${TOPDIR}/.. \
  "
```

## build/conf/local.conf
```bitbake
# Build for the Raspberry Pi Zero W
MACHINE ?= "raspberrypi0-wifi"

# Save data to the usual directories
DL_DIR ?= "${TOPDIR}/downloads"
SSTATE_DIR ?= "${TOPDIR}/sstate-cache"
TMPDIR = "${TOPDIR}/tmp"

# Build the candy distro introduced through the meta-candy layer
DISTRO ?= "candy"

BB_DISKMON_DIRS ??= "\
  STOPTASKS,${TMPDIR},1G,100K \
  STOPTASKS,${DL_DIR},1G,100K \
  STOPTASKS,${SSTATE_DIR},1G,100K \
  STOPTASKS,/tmp,100M,100K \
  ABORT,${TMPDIR},100M,1K \
  ABORT,${DL_DIR},100M,1K \
  ABORT,${SSTATE_DIR},100M,1K \
  ABORT,/tmp,10M,1K \
  "

CONF_VERSION = "1"
```

## conf/distro/candy.conf
```bitbake
# Use me in your local.conf by adding this line
#
# DISTRO ?= "candy"
#
# And don't forget to import the meta-candy layer in your bblayers.conf file
# together with all depending layers.

# This custom distro is based on poky
require conf/distro/poky.conf

DISTRO = "candy"
DISTRO_NAME = "Candy (Bitcoin Candy Dispenser Distribution)"
DISTRO_VERSION = "1.0.0"
DISTRO_CODENAME = "moon"

MAINTAINER = "David Knezic <davidknezic@gmail.com>"

LOCALCONF_VERSION = "1"

#
# Packages and features
#
# Installs all necessary software for the Candy Dispenser to run smoothly
#

# We need to add the Bluetooth and Wifi distro features
# for our Candy Dispenser to work
DISTRO_FEATURES_append += "bluez5 bluetooth wifi"

# Make sure we pull bluez 5.47 from this layer
# because 5.50 fails with go-bluetooth somehow
# https://github.com/muka/go-bluetooth/issues/69
PREFERRED_VERSION_bluez5 = "5.47"

# We need enhanced randomness
IMAGE_INSTALL_append += "rng-tools"

# We add a persistent.txt to our /data directory
IMAGE_INSTALL_append += "persistent"

# We add sweetd, which controls the dispenser
IMAGE_INSTALL_append += "sweetd"

# Add tools for transferring files over serial console
IMAGE_INSTALL_append += "lrzsz"

# Add tool for multiplexing a terminal between several processes
IMAGE_INSTALL_append += "screen"

# Network time protocol daemon for synchronizing time required by Tor
IMAGE_INSTALL_append += "ntp"

# Make the root partition read-only
IMAGE_FEATURES_append += "read-only-rootfs"

# Don't show the splash screen
IMAGE_FEATURES_remove += "splash"

#
# General settings
#

PACKAGE_CLASSES ?= "package_rpm"
EXTRA_IMAGE_FEATURES = "debug-tweaks"
USER_CLASSES ?= "buildstats image-mklibs image-prelink"

#IMAGE_CLASSES += "testimage testsdk"
#TESTIMAGE_AUTO_qemuall = "1"

#OE_TERMINAL = "auto"
PATCHRESOLVE = "noop"

#
# Mender
#
# These are all provided by the meta-mender-core and meta-mender-raspberry layers
#

MENDER_DTB_NAME_FORCE = "bcm2708-rpi-zero-w.dtb"

MENDER_FEATURES_ENABLE_append = "\
  mender-uboot \
  mender-image \
  mender-image-sd \
  mender-install \
"

MENDER_UBOOT_AUTO_CONFIGURE = "0"

# Memory card storage
MENDER_STORAGE_DEVICE = "/dev/mmcblk0"

# Memory card labeled 8GiB
MENDER_STORAGE_TOTAL_SIZE_MB = "1024" # 7555

# These are simply to align with how the "stock" RPi machines are
# configured.
MENDER_PARTITION_ALIGNMENT = "4194304"
MENDER_BOOT_PART_SIZE_MB = "40"
#MENDER_DATA_PART_SIZE_MB = "512"

# rpi-base.inc removes these as they are normally installed on to the
# vfat boot partition. To be able to update the Linux kernel Mender
# uses an image that resides on the root file system and below line
# ensures that they are installed to /boot
IMAGE_INSTALL_append += " kernel-image kernel-devicetree"

# The artifact name is the Bitcoin block number at the point of the build
# https://blockstream.info/block/00000000000000000003ecdea3822812a57c09c37e28eead593ac371b3439343
MENDER_ARTIFACT_NAME = "589014"

# Mender will build an image called `sdimg` which shall be used instead
# of `tar.bz2` `ext3` and `rpi-sdimg`  defined by meta-raspberry.
#IMAGE_FSTYPES_remove += "rpi-sdimg"
IMAGE_FSTYPES = ""

# Use the same type here as specified in ARTIFACTIMG_FSTYPE to avoid
# building an unneeded image file.
SDIMG_ROOTFS_TYPE = "ext4"
ARTIFACTIMG_FSTYPE = "ext4"

#
# Raspberry Pi settings
#
# These are provided by the meta-raspberry image
#

# We need U-Boot for Mender
# https://github.com/agherzan/meta-raspberrypi/issues/374
RPI_USE_U_BOOT = "1"

# Decrease GPU memory to minimum of 16MB so there's more CPU memory
GPU_MEM = "16"

# No need to display the Raspberry Pi boot logo
DISABLE_RPI_BOOT_LOGO = "1"

# No need to display the splash screen during boot
DISABLE_SPLASH = "1"

# Limit the core frequency to the recommended value for the Raspberry Pi Zero W,
# so that the UART interface runs constantly, making it possible to use the console
CORE_FREQ = "400"

# Make it possible to access the console of the device
ENABLE_UART = "1"
```

## conf/layer.conf
```bitbake
# We have a conf directory, add to BBPATH
BBPATH .= ":${LAYERDIR}"

# We have recipes-* directories, add to BBFILES
BBFILES += "${LAYERDIR}/recipes-*/*/*.bb \
            ${LAYERDIR}/recipes-*/*/*.bbappend"

BBFILE_COLLECTIONS += "candy"
BBFILE_PATTERN_candy = "^${LAYERDIR}/"
BBFILE_PRIORITY_candy = "10"

LAYERVERSION_candy = "4"
LAYERSERIES_COMPAT_candy = "thud"
LAYERDEPENDS_candy = "\
    core \
    yocto \
    raspberrypi \
    networking-layer \
    mender \
    mender-raspberrypi \
    "
```
